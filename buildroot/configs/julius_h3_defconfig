## buildroot/configs/julius_h3_defconfig
```kconfig
BR2_arm=y
BR2_cortex_a7=y
BR2_ARM_EABI=y
BR2_ARM_FPU_VFPV4=y
BR2_ARM_INSTRUCTIONS_THUMB2=y
BR2_TOOLCHAIN_BUILDROOT_UCLIBC=y
BR2_TOOLCHAIN_BUILDROOT_WCHAR=y
BR2_TOOLCHAIN_BUILDROOT_LOCALE=y
BR2_TOOLCHAIN_GCC_AT_LEAST_8=y
BR2_ENABLE_LTO=y
BR2_OPTIMIZE_2=y
BR2_STRIP_strip=y
BR2_LINUX_KERNEL=y
BR2_LINUX_KERNEL_CUSTOM_VERSION=y
BR2_LINUX_KERNEL_CUSTOM_VERSION_VALUE="6.6"
BR2_LINUX_KERNEL_USE_CUSTOM_CONFIG=y
BR2_LINUX_KERNEL_CUSTOM_CONFIG_FILE="$(JULIUS_BASE)/kernel/julius_h3_defconfig"
BR2_LINUX_KERNEL_IMAGE_TARGET_NAME="zImage"
BR2_LINUX_KERNEL_DTS_SUPPORT=y
BR2_LINUX_KERNEL_CUSTOM_DTS_PATH="$(JULIUS_BASE)/kernel/sun8i-h3-julius.dts"
BR2_TARGET_UBOOT=y
BR2_TARGET_UBOOT_BUILD_SYSTEM_KCONFIG=y
BR2_TARGET_UBOOT_CUSTOM_VERSION=y
BR2_TARGET_UBOOT_CUSTOM_VERSION_VALUE="2024.01"
BR2_TARGET_UBOOT_BOARD_DEFCONFIG="julius_h3"
BR2_TARGET_UBOOT_FORMAT_CUSTOM=y
BR2_TARGET_UBOOT_FORMAT_CUSTOM_NAME="u-boot-sunxi-with-spl.bin"
BR2_INIT_NONE=y
BR2_TARGET_GENERIC_HOSTNAME="JuliusOS"
BR2_TARGET_GENERIC_ISSUE="Julius OS v1.4"
BR2_TARGET_GENERIC_ROOT_PASSWD=""
BR2_TARGET_GENERIC_GETTY=n
BR2_ROOTFS_POST_BUILD_SCRIPT="$(JULIUS_BASE)/buildroot/board/julius/post-build.sh"
BR2_ROOTFS_POST_IMAGE_SCRIPT="$(JULIUS_BASE)/buildroot/board/julius/post-image.sh"
BR2_TARGET_ROOTFS_EXT2=y
BR2_TARGET_ROOTFS_EXT2_4=y
BR2_TARGET_ROOTFS_EXT2_SIZE="512M"
BR2_TARGET_ROOTFS_EXT2_LABEL="julius_root"
BR2_PACKAGE_PYTHON3=y
BR2_PACKAGE_PYTHON3_PY_PYC=y
BR2_PACKAGE_PYTHON_PYGAME=y
BR2_PACKAGE_PYTHON_REQUESTS=y
BR2_PACKAGE_PYTHON_CRYPTOGRAPHY=y
BR2_PACKAGE_PYTHON_PARAMIKO=y
BR2_PACKAGE_PYTHON_PYSERIAL=y
BR2_PACKAGE_PYTHON_NETIFACES=y
BR2_PACKAGE_LIBSDL2=y
BR2_PACKAGE_LIBSDL2_IMAGE=y
BR2_PACKAGE_LIBSDL2_TTF=y
BR2_PACKAGE_LIBPNG=y
BR2_PACKAGE_LIBJPEG_TURBO=y
BR2_PACKAGE_FREETYPE=y
BR2_PACKAGE_FONTCONFIG=y
BR2_PACKAGE_OPENSSL=y
BR2_PACKAGE_LIBSSL=y
BR2_PACKAGE_CA_CERTIFICATES=y
BR2_PACKAGE_WPA_SUPPLICANT=y
BR2_PACKAGE_WPA_SUPPLICANT_AP_SUPPORT=y
BR2_PACKAGE_WPA_SUPPLICANT_CTRL_IFACE=y
BR2_PACKAGE_DHCP=y
BR2_PACKAGE_BUSYBOX=y
BR2_PACKAGE_IPTABLES=y
BR2_PACKAGE_NFTABLES=y
BR2_PACKAGE_IPROUTE2=y
BR2_PACKAGE_WIRELESS_TOOLS=y
BR2_PACKAGE_IW=y
BR2_PACKAGE_HOSTAPD=y
BR2_PACKAGE_TCPDUMP=y
BR2_PACKAGE_NMAP=y
BR2_PACKAGE_OPENSSH=y
BR2_PACKAGE_BLUEZ5_UTILS=y
BR2_PACKAGE_BLUEZ5_UTILS_CLIENT=y
BR2_PACKAGE_LIBBLUETOOTH=y
BR2_PACKAGE_I2C_TOOLS=y
BR2_PACKAGE_E2FSPROGS=y
BR2_PACKAGE_UTIL_LINUX=y
BR2_PACKAGE_DOSFSTOOLS=y
BR2_PACKAGE_CHRONY=y
```

## kernel/julius_h3_defconfig
```kconfig
# Julius OS - Linux 6.6 LTS kernel config for Allwinner H3
# Target: Cortex-A7 quad-core, 512MB DDR3, 8GB eMMC, 320x480 display

CONFIG_ARCH_SUNXI=y
CONFIG_MACH_SUN8I=y
CONFIG_ARM_THUMB=y
CONFIG_AEABI=y
CONFIG_VFP=y
CONFIG_NEON=y
CONFIG_ARM_LPAE=n
CONFIG_SMP=y
CONFIG_NR_CPUS=4
CONFIG_PREEMPT=y
CONFIG_HZ=250
CONFIG_NO_HZ_IDLE=y

CONFIG_CPU_FREQ=y
CONFIG_CPU_FREQ_GOV_INTERACTIVE=y
CONFIG_CPU_FREQ_GOV_ONDEMAND=y
CONFIG_CPU_FREQ_DEFAULT_GOV_INTERACTIVE=y
CONFIG_ARM_SUN8I_CPUFREQ=y

CONFIG_HIGHMEM=y
CONFIG_BOUNCE=y
CONFIG_ZSWAP=y
CONFIG_ZSMALLOC=y
CONFIG_ZBUD=y

CONFIG_MMC=y
CONFIG_MMC_SUNXI=y
CONFIG_MMC_BLOCK=y
CONFIG_MMC_BLOCK_MINORS=8

CONFIG_EXT4_FS=y
CONFIG_EXT4_USE_FOR_EXT2=y
CONFIG_TMPFS=y
CONFIG_TMPFS_POSIX_ACL=y
CONFIG_OVERLAY_FS=y
CONFIG_SQUASHFS=y
CONFIG_SQUASHFS_LZ4=y
CONFIG_PROC_FS=y
CONFIG_SYSFS=y
CONFIG_DEVTMPFS=y
CONFIG_DEVTMPFS_MOUNT=y

CONFIG_FB=y
CONFIG_FB_SIMPLE=y
CONFIG_BACKLIGHT_CLASS_DEVICE=y
CONFIG_BACKLIGHT_PWM=y
CONFIG_FB_TFT=y
CONFIG_FB_TFT_ST7796=y
CONFIG_DRM=n
CONFIG_FRAMEBUFFER_CONSOLE=y
CONFIG_FRAMEBUFFER_CONSOLE_ROTATION=y

CONFIG_SPI=y
CONFIG_SPI_SUN6I=y
CONFIG_SPI_SPIDEV=y

CONFIG_I2C=y
CONFIG_I2C_MV64XXX=y
CONFIG_I2C_CHARDEV=y
CONFIG_CHARGER_BQ25895=y
CONFIG_POWER_SUPPLY=y

CONFIG_INPUT=y
CONFIG_INPUT_EVDEV=y
CONFIG_INPUT_TOUCHSCREEN=y
CONFIG_TOUCHSCREEN_GENERIC=y

CONFIG_GPIOLIB=y
CONFIG_GPIO_SYSFS=y
CONFIG_GPIO_SUNXI=y
CONFIG_PINCTRL_SUN8I_H3=y

CONFIG_CFG80211=y
CONFIG_MAC80211=y
CONFIG_RFKILL=y
CONFIG_RTL8723DS=m

CONFIG_BT=y
CONFIG_BT_HCIUART=y
CONFIG_BT_HCIUART_RTL=y
CONFIG_BT_RFCOMM=y
CONFIG_BT_BNEP=y

CONFIG_USB_GADGET=y
CONFIG_USB_SUNXI=y
CONFIG_USB_G_SERIAL=y
CONFIG_USB_MASS_STORAGE=y

CONFIG_NET=y
CONFIG_INET=y
CONFIG_IPV6=y
CONFIG_PACKET=y
CONFIG_UNIX=y
CONFIG_NETFILTER=y
CONFIG_NF_TABLES=y
CONFIG_NFT_FILTER=y
CONFIG_IP_NF_IPTABLES=y
CONFIG_IP_NF_FILTER=y
CONFIG_IP_NF_NAT=y
CONFIG_NF_NAT=y
CONFIG_NETFILTER_XT_MATCH_CONNTRACK=y
CONFIG_IP_NF_MANGLE=y
CONFIG_BRIDGE=y
CONFIG_VLAN_8021Q=y

CONFIG_TLS=y
CONFIG_CRYPTO=y
CONFIG_CRYPTO_AES=y
CONFIG_CRYPTO_SHA256=y
CONFIG_CRYPTO_HMAC=y
CONFIG_CRYPTO_GCM=y
CONFIG_CRYPTO_USER_API_HASH=y
CONFIG_CRYPTO_USER_API_SKCIPHER=y

CONFIG_SECURITY=y
CONFIG_SECCOMP=y
CONFIG_SECCOMP_FILTER=y
CONFIG_KEYS=y
CONFIG_TRUSTED_KEYS=y
CONFIG_ENCRYPTED_KEYS=y
CONFIG_SECURITY_SELINUX=n

CONFIG_RTC_CLASS=y
CONFIG_RTC_DRV_SUN6I=y

CONFIG_WATCHDOG=y
CONFIG_SUNXI_WATCHDOG=y

CONFIG_SOUND=y
CONFIG_SND=y
CONFIG_SND_SOC=y
CONFIG_SND_SUN8I_CODEC=y

CONFIG_PCCARD=n
CONFIG_PCMCIA=n
CONFIG_INFINIBAND=n
CONFIG_IOMMU_SUPPORT=n
CONFIG_ACPI=n
CONFIG_EFI=n
CONFIG_HIBERNATION=n
CONFIG_SUSPEND=y

CONFIG_BINFMT_ELF=y
CONFIG_BINFMT_SCRIPT=y
CONFIG_DEVMEM=y

CONFIG_PRINTK=y
CONFIG_EARLY_PRINTK=y
CONFIG_DEBUG_KERNEL=n
CONFIG_KALLSYMS=n
CONFIG_FTRACE=n
```

## uboot/julius_h3_defconfig
```kconfig
CONFIG_ARM=y
CONFIG_ARCH_SUNXI=y
CONFIG_DEFAULT_DEVICE_TREE="sun8i-h3-julius"
CONFIG_SPL=y
CONFIG_MACH_SUN8I_H3=y
CONFIG_DRAM_CLK=672
CONFIG_DRAM_ZQ=3881979
CONFIG_DRAM_ODT_EN=y
CONFIG_MMC=y
CONFIG_MMC_SUNXI=y
CONFIG_MMC_SUNXI_SLOT_EXTRA=2
CONFIG_GENERIC_MMC=y
CONFIG_BOOTDELAY=0
CONFIG_USE_BOOTCOMMAND=y
CONFIG_BOOTCOMMAND="run julius_boot"
CONFIG_EXTRA_ENV_SETTINGS="julius_boot=echo 'Julius OS'; mmc dev 2; load mmc 2:1 0x42000000 zImage; load mmc 2:1 0x43000000 sun8i-h3-julius.dtb; load mmc 2:1 0x43100000 julius_initramfs_h3.cpio.gz; bootz 0x42000000 0x43100000 0x43000000\0"
CONFIG_VIDEO_SUNXI=y
CONFIG_VIDEO_LCD_MODE="x:320,y:480,depth:16,pclk_khz:27000,le:10,ri:20,up:5,lo:10,hs:20,vs:5,sync:3,vmode:0"
CONFIG_VIDEO_LCD_DCLK_PHASE=1
CONFIG_VIDEO_LCD_POWER="PC7"
CONFIG_VIDEO_LCD_BL_EN="PC6"
CONFIG_VIDEO_LCD_BL_PWM="PWM0"
CONFIG_SPLASH_SCREEN=y
CONFIG_SPLASH_SOURCE=y
CONFIG_SPLASH_SCREEN_ALIGN=y
CONFIG_CONS_INDEX=1
CONFIG_BAUDRATE=115200
CONFIG_CMD_MMC=y
CONFIG_CMD_FAT=y
CONFIG_CMD_EXT4=y
CONFIG_CMD_BOOTZ=y
CONFIG_CMD_ECHO=y
CONFIG_CMD_LOAD=y
CONFIG_CMD_ENV=y
CONFIG_CMD_SAVEENV=y
CONFIG_ENV_IS_IN_MMC=y
CONFIG_ENV_OFFSET=0x88000
CONFIG_ENV_SIZE=0x20000
CONFIG_CMD_NET=n
CONFIG_CMD_NFS=n
CONFIG_CMD_PING=n
CONFIG_CMD_USB=n
```
